## lab4/meta-bpo/conf/layer.conf
```bitbake
# We have a conf and classes directory, add to BBPATH
BBPATH .= ":${LAYERDIR}"

# We have recipes-* directories, add to BBFILES
BBFILES += "${LAYERDIR}/recipes-*/*/*.bb \
	${LAYERDIR}/recipes-*/*/*.bbappend"

BBFILE_COLLECTIONS += "bpo"
BBFILE_PATTERN_bpo = "^${LAYERDIR}/"
BBFILE_PRIORITY_bpo = "1"
```
